#include "game_dinosaur.h"
#include "stdlib.h"//含有随机数函数库

/* 谷歌小恐龙游戏
 * 参考：https://github.com/hjl240/STM32DinoGame
 * ChatGPT辅助创作     TKWTL 2025/07/03
 * 按下ENTER或”上“键进行跳跃，跳跃高度与按下时长无关，任何时刻按BACK键退出，进度保存
 * 新增起始动画
 * 速度：100分/300分/600分增加一档，之后不再增加
 * 待实现功能：飞鸟；蹲下；天色转换
 */

// 位图数据
#define DINO_W  16
#define DINO_H  16
const uint8_t DINO[2][32] = {
    {0x00,0x7e,0x00,0xfb,0x00,0xff,0x00,0xff,0x00,0x0f,0x81,0x7f,0xc1,0x07,0xe3,0x1f,
    0xf7,0x17,0xff,0x07,0xfe,0x07,0xfc,0x03,0xf8,0x01,0xb0,0x01,0x60,0x01,0x00,0x03},
    {0x00,0x7e,0x00,0xfb,0x00,0xff,0x00,0xff,0x00,0x0f,0x81,0x7f,0xc1,0x07,0xe3,0x1f,
    0xf7,0x17,0xff,0x07,0xfe,0x07,0xfc,0x03,0xf8,0x01,0x30,0x03,0x10,0x00,0x30,0x00}
};// 恐龙行走动画（2帧，每帧16x16像素）
const uint8_t DINO_JUMP[] = {
    0x00,0x7e,0x00,0xfb,0x00,0xff,0x00,0xff,0x00,0x0f,0x81,0x7f,0xc1,0x07,0xe3,0x1f,
    0xf7,0x17,0xff,0x07,0xfe,0x07,0xfc,0x03,0xf8,0x01,0xb0,0x01,0x10,0x01,0x30,0x03
};
const uint8_t DINO_END[] = {
    0x00,0x7e,0x00,0xf1,0x00,0xf5,0x00,0xf1,0x00,0xff,0x81,0x7f,0xc1,0x07,0xe3,0x1f,
    0xf7,0x17,0xff,0x07,0xfe,0x07,0xfc,0x03,0xf8,0x01,0xb0,0x01,0x10,0x01,0x30,0x03
};

#define GROUND_W    597
#define GROUND_H    8
const uint8_t GROUND[] =  {
    0x00,0x00,0x00,0x00,0x00,0x00,0x00,0x00,0x00,0x00,0x00,0x00,0x00,0x00,0x00,0x00,
    0x00,0x00,0x00,0x00,0x00,0x08,0x80,0x00,0x10,0x00,0x01,0x10,0x00,0x02,0x00,0x00,
    0x00,0x00,0x00,0x00,0x00,0x00,0x00,0x00,0x00,0x00,0x00,0x00,0x00,0x00,0x00,0x00,
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    0x00,0x00,0x00,0x0c,0x00,0x00,0x00,0x04
}; // 地面图案


static float score = 0; // 当前分数（也兼作坐标）
static uint8_t life = 3; // 生命值

const uint8_t CACTUS_0[] = {
    0x18,0x18,0x18,0x18,0xdb,0xdb,0xdb,0xdb,0xdb,0x7f,0x3e,0x18,0x18,0x18,0x18,0x1c
}; // 小仙人掌（8x16像素）
const uint8_t CACTUS_1[] = {
    0x08,0x10,0x18,0x18,0x58,0x9a,0x58,0x9a,0x59,0x9a,0x5b,0x9a,0x5b,0x9e,0x7b,0xdc,
    0x3b,0xf8,0x1f,0x78,0x1e,0x18,0x18,0x18,0xd8,0x1b,0x18,0x18,0x18,0x18,0x98,0x1b
}; // 中仙人掌（16x16像素）
const uint8_t CACTUS_2[] = {
    0x08,0x18,0x10,0x18,0x1a,0x3a,0x58,0x1b,0xba,0x58,0x5b,0xfa,0x59,0xdb,0xfa,0x5b,
    0xdb,0xfa,0x5b,0xdb,0xfa,0x7b,0xdb,0xbe,0x3b,0xdb,0xfc,0x1f,0xdb,0x78,0x1e,0xde,
    0x18,0x18,0x78,0x18,0xdb,0x9b,0xdb,0x18,0x1a,0x18,0x18,0x18,0x18,0x18,0x18,0x18
}; // 大仙人掌（24x16像素）
const uint8_t CACTUS_3[] = {
    0x08,0x04,0x10,0x18,0x0c,0x18,0x18,0x2c,0x1a,0x18,0x2c,0x9a,0x59,0x2c,0xda,0x5b,
    0x3c,0xda,0x5b,0x1d,0xde,0x5b,0x4d,0xdc,0x5b,0x4d,0xd9,0x7f,0x4d,0x79,0x3e,0x4f,
    0x39,0x18,0xec,0x19,0x18,0x4c,0x18,0xf8,0x4d,0xd9,0x1b,0x4c,0x18,0xdc,0xcc,0x18
}; // 组合仙人掌（24x16像素）

Dino_Cactus_Image_t cactus_image[4] = {{CACTUS_0, 8, 16},{CACTUS_1, 16, 16},{CACTUS_2, 24, 16},{CACTUS_3, 24, 16}};//注册仙人掌的形状

Dino_Cactus_t cactus_pool[CACTUS_POOL_DEPTH];//仙人掌对象池
// 仙人掌的初始化
static void cactus_init(){
    uint8_t i;
    for(i = 0; i < CACTUS_POOL_DEPTH; i++){
        cactus_pool[i].available = 0;
        cactus_pool[i].start_pos = CACTUS_RESPAWN_MIN+ rand()% (CACTUS_RESPAWN_MAX- CACTUS_RESPAWN_MIN);//随机指定生成冷却
    }
}
// 仙人掌的绘制
static void cactus_draw(){
    uint8_t i, j;
    int pos;
    for(i = 0; i < CACTUS_POOL_DEPTH; i++){
        if(cactus_pool[i].available){
            pos = UI_HOR_RES- ((uint32_t)score- cactus_pool[i].start_pos);//显示坐标计算
            Disp_DrawXBMP(pos, DINO_DEFAULT_HEIGHT, cactus_image[cactus_pool[i].type].width, cactus_image[cactus_pool[i].type].height, cactus_image[cactus_pool[i].type].pdata);//绘制图案
        }
    }
}
// 仙人掌的处理
static void cactus_process(){
    uint8_t i, j;
    int pos;
    for(i = 0; i < CACTUS_POOL_DEPTH; i++){
        if(cactus_pool[i].available){
            pos = UI_HOR_RES- ((uint32_t)score- cactus_pool[i].start_pos);//显示坐标计算
            if(pos < -cactus_image[cactus_pool[i].type].width){//标记对象不可用的判断
                cactus_pool[i].available = 0;
                cactus_pool[i].start_pos = CACTUS_RESPAWN_MIN+ rand()% (CACTUS_RESPAWN_MAX- CACTUS_RESPAWN_MIN);//随机指定生成冷却
            }
        }
        else{
            cactus_pool[i].start_pos--;//倒计时
            if(cactus_pool[i].start_pos == 0){//倒计时结束
                cactus_pool[i].available = 1;
                pos = (uint32_t)score;
                for(j = 0; j < CACTUS_POOL_DEPTH; j++)
                    if(j != i && cactus_pool[j].available == 1)
                        if(cactus_pool[j].start_pos+ CACTUS_SPACE > pos)
                            pos = cactus_pool[j].start_pos+ CACTUS_SPACE;
                cactus_pool[i].start_pos = pos;
                //根据分数控制生成类型
                if(score < 500) cactus_pool[i].type = 0; 
                else if(score < 2500) cactus_pool[i].type = rand()% 2; 
                else cactus_pool[i].type = rand()% 4;
            }
        }
    }
}
//仙人掌碰撞检测
uint8_t cactus_collision(int pos_x, int pos_y){
    uint8_t i;
    int pos;
    int dino_pos_x1 = pos_x+ 1;
    int dino_pos_x2 = pos_x+ DINO_W- 1;
    int cactus_pos_x1;
    int cactus_pos_x2;
    for(i = 0; i < CACTUS_POOL_DEPTH; i++){
        if(cactus_pool[i].available){
            pos = UI_HOR_RES- ((uint32_t)score- cactus_pool[i].start_pos);
            cactus_pos_x1 = pos;
            cactus_pos_x2 = pos+ cactus_image[cactus_pool[i].type].width;
            if(dino_pos_x2 > cactus_pos_x1 && dino_pos_x1 < cactus_pos_x2)
                if(pos_y > DINO_DEFAULT_HEIGHT- DINO_H+ 4)
                    return 1;
        }
    }
    return 0;//默认不发生碰撞
}


Dino_Cloud_t cloud_pool[CLOUD_POOL_DEPTH];//云对象池

#define CLOUD_W 24
#define CLOUD_H 8
const uint8_t CLOUD[] = {
    0x00,0xfc,0x00,0x00,0x9e,0x01,0x00,0x02,0x03,0x80,0x03,0x1f,
    0xf8,0x80,0x70,0x7c,0x00,0x60,0x0e,0x00,0xc0,0xf7,0xff,0xff
};// 云朵图案

// 云的初始化
static void cloud_init(){
    uint8_t i;
    for(i = 0; i < CLOUD_POOL_DEPTH; i++){
        cloud_pool[i].available = 0;
        cloud_pool[i].start_pos = CLOUD_RESPAWN_MIN+ rand()% (CLOUD_RESPAWN_MAX- CLOUD_RESPAWN_MIN);//随机指定生成冷却
    }
}
// 云的绘制
static void cloud_draw(){
    uint8_t i;
    int pos;
    for(i = 0; i < CLOUD_POOL_DEPTH; i++){
        if(cloud_pool[i].available){
            pos = UI_HOR_RES- ((uint32_t)score- cloud_pool[i].start_pos)/ cloud_pool[i].speed_div;//显示坐标计算
            Disp_DrawXBMP(pos, cloud_pool[i].y_pos, CLOUD_W, CLOUD_H, CLOUD);//绘制图案
        }
    }
}
// 云的处理
static void cloud_process(){
    uint8_t i;
    int pos;
    for(i = 0; i < CLOUD_POOL_DEPTH; i++){
        if(cloud_pool[i].available){
            pos = UI_HOR_RES- ((uint32_t)score- cloud_pool[i].start_pos)/ cloud_pool[i].speed_div;//显示坐标计算
            if(pos < -CLOUD_W){//标记对象不可用的判断
                cloud_pool[i].available = 0;
                cloud_pool[i].start_pos = CLOUD_RESPAWN_MIN+ rand()% (CLOUD_RESPAWN_MAX- CLOUD_RESPAWN_MIN);//随机指定生成冷却
            }
        }
        else{
            cloud_pool[i].start_pos--;
            if(cloud_pool[i].start_pos == 0){
                cloud_pool[i].available = 1;
                cloud_pool[i].start_pos = (uint32_t)score;
                cloud_pool[i].y_pos = CLOUD_YPOS_MIN+ rand()% (CLOUD_YPOS_MAX- CLOUD_YPOS_MIN);//随机指定生成高度
                cloud_pool[i].speed_div = CLOUD_SPEED_DIVID_MIN+ rand()% (CLOUD_SPEED_DIVID_MAX- CLOUD_SPEED_DIVID_MIN);//随机指定滚动速度
            }
        }
    }
}

// 初始化游戏
static void init_game(void) {
    score = 0;
    life = 3;
    cloud_init();
    cactus_init();
}

// 游戏状态枚举
typedef enum {
    PAUSED,//游戏未开始
    PLAYING,
    FAILED
}Dino_Game_State_t;

// 提供给 UI 调用的谷歌小恐龙实现函数
void Game_DinoSaur(ui_t *ui) {
    char buf[16]; // 显示用缓冲区数组
    uint8_t color; // 设置颜色
    uint8_t i, x, y; // 遍历和定位变量
    
    static uint16_t high_score = 0; // 最高分数
    float score_step;//分数增加值
    static uint8_t game_first_inited = 0;//游戏已完成首次初始化
    
    static Dino_Game_State_t current_state = PLAYING; // 游戏状态
    
    static float dino_height = DINO_DEFAULT_HEIGHT; // 恐龙高度
    static float dino_speed_y = 0; // 恐龙垂直速度
    uint8_t dino_frame, dino_coll, last_coll; // 恐龙动画帧
    

    // 初始化
    Disp_SetFont(font_menu_main_h12w6); // 设置字体
    srand(sTime.Seconds + sTime.Date + sTime.Month + sTime.Year); // 初始化随机种子
    if(game_first_inited == 0){//首次启动
        init_game();
        game_first_inited = 1;
    }
    
    // 主循环
    while(1){
        if(current_state == PLAYING){
            //分数增加与速度控制
            if(score < 500U) score_step = 2;
            else if(score < 2500U) score_step = score/ 2000+ 1.75;
            else if(score < 22500U) score_step = score/ 20000+ 2.875;
            else score_step = 4;
            score += score_step;
            
            cloud_process();//处理云朵
            cactus_process();//处理仙人掌
            if(dino_height < DINO_DEFAULT_HEIGHT){
                dino_speed_y += DINO_JUMP_GRAVITY;
                dino_height += dino_speed_y;
                if(dino_height > DINO_DEFAULT_HEIGHT) dino_height = DINO_DEFAULT_HEIGHT;
            }//处理跳跃，单纯的二次函数式跳跃曲线，高度与按键时长无关
        
            dino_coll = cactus_collision(DINO_DEFAULT_POS_X, (int)dino_height);//碰撞检测
            if(dino_coll == 1 && last_coll == 0){//边沿触发
                life--;
                if(life == 0) {
                    current_state = FAILED;
                    high_score = score;
                }
            }
            last_coll = dino_coll;
        }
        
/****************显示循环，其中后绘制的图案会覆盖先绘制的**********************/
        //两种颜色下的清屏
        Disp_SetDrawColor(&ui->bgColor);
        Disp_DrawBox(0, 0, UI_HOR_RES, UI_VER_RES);
        color = ui->bgColor^ 0x01;
        Disp_SetDrawColor(&color);
        
        Disp_SetBitmapMode(1);//设置前景透明
        //地面循环绘制
        Disp_DrawXBMP(-((uint32_t)score% GROUND_W), UI_VER_RES- 1- GROUND_H, GROUND_W, GROUND_H, GROUND);
        if((uint32_t)score% GROUND_W > GROUND_W- UI_HOR_RES) Disp_DrawXBMP(GROUND_W- ((uint32_t)score% GROUND_W), UI_VER_RES- 1- GROUND_H, GROUND_W, GROUND_H, GROUND);
        cloud_draw();//绘制云朵
        cactus_draw();//绘制仙人掌
        // 显示生命数与得分
        switch(life){
            case 3: Disp_DrawStr(1, 9, "***"); break;
            case 2: Disp_DrawStr(1, 9, "**" ); break;
            case 1: Disp_DrawStr(1, 9, "*"  ); break;
            default: break;
        }
        sprintf(buf, "HI %05d %05d", high_score/ 2, (uint32_t)score/ 2);
        Disp_DrawStr(44, 9, buf);
        //绘制恐龙
        dino_frame = ((uint32_t)score/ 6)% 2;
        if(dino_coll) Disp_DrawXBMP(DINO_DEFAULT_POS_X, dino_height, DINO_W, DINO_H, DINO_END);
        else if(dino_height != DINO_DEFAULT_HEIGHT) Disp_DrawXBMP(DINO_DEFAULT_POS_X, dino_height, DINO_W, DINO_H, DINO_JUMP);
        else Disp_DrawXBMP(DINO_DEFAULT_POS_X, dino_height, DINO_W, DINO_H, DINO[dino_frame]);
        
        Disp_SetBitmapMode(0);//设置前景不透明
        if(current_state == FAILED){//显示失败提示与关于信息
            //Disp_DrawFrame(32, 10, 96, 46);
            Disp_DrawStr(34, 21, "Game Over!!");
            Disp_DrawStr(22, 31, "Dino Game V0.1");
            Disp_DrawStr(34, 41, "from hjl240");
            Disp_DrawStr(34, 52, "Jump to Restart");
        }
        
/*****************************按键操作识别*************************************/
        switch(indevScan()){
            case UI_ACTION_BACK://退出
                ui->action = UI_ACTION_ENTER;
                return;
            case UI_ACTION_PLUS:
            case UI_ACTION_ENTER://跳跃
                if(current_state == FAILED){//失败情况下重新开始
                    current_state = PLAYING;
                    init_game();
                    dino_height = DINO_DEFAULT_HEIGHT;
                }
                else if(dino_height == DINO_DEFAULT_HEIGHT){//未处于跳跃过程中
                    dino_height += DINO_JUMP_SPEED_INITIAL;
                    dino_speed_y = DINO_JUMP_SPEED_INITIAL;
                }
                break;
            case UI_ACTION_NONE:
                break;
            default:
                break;
        }

        // 发送显示缓冲区
        Disp_SendBuffer();
        osDelay(pdMS_TO_TICKS(16));//可选的帧延时，保证帧刷新时间在100Hz左右
    }
}
